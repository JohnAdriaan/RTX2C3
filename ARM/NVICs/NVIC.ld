/*
 * \file ARM/NVICs/NVIC.ld
 * 
 * © 2019 John Adriaan. Licensed under the "3-clause BSD License"
 *
 * Included by `ARM/ARM.ld` linker script to PROVIDE (literally!) default implementations
 * for all ARM-based IRQs.
 */

/*
 * Function name mangling is of the form:
 * "_Z" : Mangled name
 * "N"  : (optional) Nested (used for namespace or sub-definitions)
 * <#>  : Number of characters
 * <$>  : String
 * [#$] : (if Nested) More of the same
 * "E"  : (if Nested) End of Nesting
 * "v"  : void parameters 
 */

/* Default `ARM::NVICs::IRQ()` to `ARM::ISRs::Default()` */
PROVIDE ( _ZN3ARM5NVICs3IRQEv = _ZN3ARM4ISRs7DefaultEv );

/* Default all `ARM::NVICs::IRQ#()`s to `ARM::NVICs::IRQ()` (in turn, defaulted above). */
PROVIDE ( _ZN3ARM5NVICs4IRQ0Ev   = _ZN3ARM5NVICs3IRQEv ); /* ARM::NVICs::IRQ#() => ARM::NVICs::IRQ() */
PROVIDE ( _ZN3ARM5NVICs4IRQ1Ev   = _ZN3ARM5NVICs3IRQEv );
PROVIDE ( _ZN3ARM5NVICs4IRQ2Ev   = _ZN3ARM5NVICs3IRQEv );
PROVIDE ( _ZN3ARM5NVICs4IRQ3Ev   = _ZN3ARM5NVICs3IRQEv );
PROVIDE ( _ZN3ARM5NVICs4IRQ4Ev   = _ZN3ARM5NVICs3IRQEv );
PROVIDE ( _ZN3ARM5NVICs4IRQ5Ev   = _ZN3ARM5NVICs3IRQEv );
PROVIDE ( _ZN3ARM5NVICs4IRQ6Ev   = _ZN3ARM5NVICs3IRQEv );
PROVIDE ( _ZN3ARM5NVICs4IRQ7Ev   = _ZN3ARM5NVICs3IRQEv );
PROVIDE ( _ZN3ARM5NVICs4IRQ8Ev   = _ZN3ARM5NVICs3IRQEv );
PROVIDE ( _ZN3ARM5NVICs4IRQ9Ev   = _ZN3ARM5NVICs3IRQEv );
PROVIDE ( _ZN3ARM5NVICs5IRQ10Ev  = _ZN3ARM5NVICs3IRQEv );
PROVIDE ( _ZN3ARM5NVICs5IRQ11Ev  = _ZN3ARM5NVICs3IRQEv );
PROVIDE ( _ZN3ARM5NVICs5IRQ12Ev  = _ZN3ARM5NVICs3IRQEv );
PROVIDE ( _ZN3ARM5NVICs5IRQ13Ev  = _ZN3ARM5NVICs3IRQEv );
PROVIDE ( _ZN3ARM5NVICs5IRQ14Ev  = _ZN3ARM5NVICs3IRQEv );
PROVIDE ( _ZN3ARM5NVICs5IRQ15Ev  = _ZN3ARM5NVICs3IRQEv );
PROVIDE ( _ZN3ARM5NVICs5IRQ16Ev  = _ZN3ARM5NVICs3IRQEv );
PROVIDE ( _ZN3ARM5NVICs5IRQ17Ev  = _ZN3ARM5NVICs3IRQEv );
PROVIDE ( _ZN3ARM5NVICs5IRQ18Ev  = _ZN3ARM5NVICs3IRQEv );
PROVIDE ( _ZN3ARM5NVICs5IRQ19Ev  = _ZN3ARM5NVICs3IRQEv );
PROVIDE ( _ZN3ARM5NVICs5IRQ20Ev  = _ZN3ARM5NVICs3IRQEv );
PROVIDE ( _ZN3ARM5NVICs5IRQ21Ev  = _ZN3ARM5NVICs3IRQEv );
PROVIDE ( _ZN3ARM5NVICs5IRQ22Ev  = _ZN3ARM5NVICs3IRQEv );
PROVIDE ( _ZN3ARM5NVICs5IRQ23Ev  = _ZN3ARM5NVICs3IRQEv );
PROVIDE ( _ZN3ARM5NVICs5IRQ24Ev  = _ZN3ARM5NVICs3IRQEv );
PROVIDE ( _ZN3ARM5NVICs5IRQ25Ev  = _ZN3ARM5NVICs3IRQEv );
PROVIDE ( _ZN3ARM5NVICs5IRQ26Ev  = _ZN3ARM5NVICs3IRQEv );
PROVIDE ( _ZN3ARM5NVICs5IRQ27Ev  = _ZN3ARM5NVICs3IRQEv );
PROVIDE ( _ZN3ARM5NVICs5IRQ28Ev  = _ZN3ARM5NVICs3IRQEv );
PROVIDE ( _ZN3ARM5NVICs5IRQ29Ev  = _ZN3ARM5NVICs3IRQEv );
PROVIDE ( _ZN3ARM5NVICs5IRQ30Ev  = _ZN3ARM5NVICs3IRQEv );
PROVIDE ( _ZN3ARM5NVICs5IRQ31Ev  = _ZN3ARM5NVICs3IRQEv );
PROVIDE ( _ZN3ARM5NVICs5IRQ32Ev  = _ZN3ARM5NVICs3IRQEv );
PROVIDE ( _ZN3ARM5NVICs5IRQ33Ev  = _ZN3ARM5NVICs3IRQEv );
PROVIDE ( _ZN3ARM5NVICs5IRQ34Ev  = _ZN3ARM5NVICs3IRQEv );
PROVIDE ( _ZN3ARM5NVICs5IRQ35Ev  = _ZN3ARM5NVICs3IRQEv );
PROVIDE ( _ZN3ARM5NVICs5IRQ36Ev  = _ZN3ARM5NVICs3IRQEv );
PROVIDE ( _ZN3ARM5NVICs5IRQ37Ev  = _ZN3ARM5NVICs3IRQEv );
PROVIDE ( _ZN3ARM5NVICs5IRQ38Ev  = _ZN3ARM5NVICs3IRQEv );
PROVIDE ( _ZN3ARM5NVICs5IRQ39Ev  = _ZN3ARM5NVICs3IRQEv );
PROVIDE ( _ZN3ARM5NVICs5IRQ40Ev  = _ZN3ARM5NVICs3IRQEv );
PROVIDE ( _ZN3ARM5NVICs5IRQ41Ev  = _ZN3ARM5NVICs3IRQEv );
PROVIDE ( _ZN3ARM5NVICs5IRQ42Ev  = _ZN3ARM5NVICs3IRQEv );
PROVIDE ( _ZN3ARM5NVICs5IRQ43Ev  = _ZN3ARM5NVICs3IRQEv );
PROVIDE ( _ZN3ARM5NVICs5IRQ44Ev  = _ZN3ARM5NVICs3IRQEv );
PROVIDE ( _ZN3ARM5NVICs5IRQ45Ev  = _ZN3ARM5NVICs3IRQEv );
PROVIDE ( _ZN3ARM5NVICs5IRQ46Ev  = _ZN3ARM5NVICs3IRQEv );
PROVIDE ( _ZN3ARM5NVICs5IRQ47Ev  = _ZN3ARM5NVICs3IRQEv );
PROVIDE ( _ZN3ARM5NVICs5IRQ48Ev  = _ZN3ARM5NVICs3IRQEv );
PROVIDE ( _ZN3ARM5NVICs5IRQ49Ev  = _ZN3ARM5NVICs3IRQEv );
PROVIDE ( _ZN3ARM5NVICs5IRQ50Ev  = _ZN3ARM5NVICs3IRQEv );
PROVIDE ( _ZN3ARM5NVICs5IRQ51Ev  = _ZN3ARM5NVICs3IRQEv );
PROVIDE ( _ZN3ARM5NVICs5IRQ52Ev  = _ZN3ARM5NVICs3IRQEv );
PROVIDE ( _ZN3ARM5NVICs5IRQ53Ev  = _ZN3ARM5NVICs3IRQEv );
PROVIDE ( _ZN3ARM5NVICs5IRQ54Ev  = _ZN3ARM5NVICs3IRQEv );
PROVIDE ( _ZN3ARM5NVICs5IRQ55Ev  = _ZN3ARM5NVICs3IRQEv );
PROVIDE ( _ZN3ARM5NVICs5IRQ56Ev  = _ZN3ARM5NVICs3IRQEv );
PROVIDE ( _ZN3ARM5NVICs5IRQ57Ev  = _ZN3ARM5NVICs3IRQEv );
PROVIDE ( _ZN3ARM5NVICs5IRQ58Ev  = _ZN3ARM5NVICs3IRQEv );
PROVIDE ( _ZN3ARM5NVICs5IRQ59Ev  = _ZN3ARM5NVICs3IRQEv );
PROVIDE ( _ZN3ARM5NVICs5IRQ60Ev  = _ZN3ARM5NVICs3IRQEv );
PROVIDE ( _ZN3ARM5NVICs5IRQ61Ev  = _ZN3ARM5NVICs3IRQEv );
PROVIDE ( _ZN3ARM5NVICs5IRQ62Ev  = _ZN3ARM5NVICs3IRQEv );
PROVIDE ( _ZN3ARM5NVICs5IRQ63Ev  = _ZN3ARM5NVICs3IRQEv );
PROVIDE ( _ZN3ARM5NVICs5IRQ64Ev  = _ZN3ARM5NVICs3IRQEv );
PROVIDE ( _ZN3ARM5NVICs5IRQ65Ev  = _ZN3ARM5NVICs3IRQEv );
PROVIDE ( _ZN3ARM5NVICs5IRQ66Ev  = _ZN3ARM5NVICs3IRQEv );
PROVIDE ( _ZN3ARM5NVICs5IRQ67Ev  = _ZN3ARM5NVICs3IRQEv );
PROVIDE ( _ZN3ARM5NVICs5IRQ68Ev  = _ZN3ARM5NVICs3IRQEv );
PROVIDE ( _ZN3ARM5NVICs5IRQ69Ev  = _ZN3ARM5NVICs3IRQEv );
PROVIDE ( _ZN3ARM5NVICs5IRQ70Ev  = _ZN3ARM5NVICs3IRQEv );
PROVIDE ( _ZN3ARM5NVICs5IRQ71Ev  = _ZN3ARM5NVICs3IRQEv );
PROVIDE ( _ZN3ARM5NVICs5IRQ72Ev  = _ZN3ARM5NVICs3IRQEv );
PROVIDE ( _ZN3ARM5NVICs5IRQ73Ev  = _ZN3ARM5NVICs3IRQEv );
PROVIDE ( _ZN3ARM5NVICs5IRQ74Ev  = _ZN3ARM5NVICs3IRQEv );
PROVIDE ( _ZN3ARM5NVICs5IRQ75Ev  = _ZN3ARM5NVICs3IRQEv );
PROVIDE ( _ZN3ARM5NVICs5IRQ76Ev  = _ZN3ARM5NVICs3IRQEv );
PROVIDE ( _ZN3ARM5NVICs5IRQ77Ev  = _ZN3ARM5NVICs3IRQEv );
PROVIDE ( _ZN3ARM5NVICs5IRQ78Ev  = _ZN3ARM5NVICs3IRQEv );
PROVIDE ( _ZN3ARM5NVICs5IRQ79Ev  = _ZN3ARM5NVICs3IRQEv );
PROVIDE ( _ZN3ARM5NVICs5IRQ80Ev  = _ZN3ARM5NVICs3IRQEv );
PROVIDE ( _ZN3ARM5NVICs5IRQ81Ev  = _ZN3ARM5NVICs3IRQEv );
PROVIDE ( _ZN3ARM5NVICs5IRQ82Ev  = _ZN3ARM5NVICs3IRQEv );
PROVIDE ( _ZN3ARM5NVICs5IRQ83Ev  = _ZN3ARM5NVICs3IRQEv );
PROVIDE ( _ZN3ARM5NVICs5IRQ84Ev  = _ZN3ARM5NVICs3IRQEv );
PROVIDE ( _ZN3ARM5NVICs5IRQ85Ev  = _ZN3ARM5NVICs3IRQEv );
PROVIDE ( _ZN3ARM5NVICs5IRQ86Ev  = _ZN3ARM5NVICs3IRQEv );
PROVIDE ( _ZN3ARM5NVICs5IRQ87Ev  = _ZN3ARM5NVICs3IRQEv );
PROVIDE ( _ZN3ARM5NVICs5IRQ88Ev  = _ZN3ARM5NVICs3IRQEv );
PROVIDE ( _ZN3ARM5NVICs5IRQ89Ev  = _ZN3ARM5NVICs3IRQEv );
PROVIDE ( _ZN3ARM5NVICs5IRQ90Ev  = _ZN3ARM5NVICs3IRQEv );
PROVIDE ( _ZN3ARM5NVICs5IRQ91Ev  = _ZN3ARM5NVICs3IRQEv );
PROVIDE ( _ZN3ARM5NVICs5IRQ92Ev  = _ZN3ARM5NVICs3IRQEv );
PROVIDE ( _ZN3ARM5NVICs5IRQ93Ev  = _ZN3ARM5NVICs3IRQEv );
PROVIDE ( _ZN3ARM5NVICs5IRQ94Ev  = _ZN3ARM5NVICs3IRQEv );
PROVIDE ( _ZN3ARM5NVICs5IRQ95Ev  = _ZN3ARM5NVICs3IRQEv );
PROVIDE ( _ZN3ARM5NVICs5IRQ96Ev  = _ZN3ARM5NVICs3IRQEv );
PROVIDE ( _ZN3ARM5NVICs5IRQ97Ev  = _ZN3ARM5NVICs3IRQEv );
PROVIDE ( _ZN3ARM5NVICs5IRQ98Ev  = _ZN3ARM5NVICs3IRQEv );
PROVIDE ( _ZN3ARM5NVICs5IRQ99Ev  = _ZN3ARM5NVICs3IRQEv );
PROVIDE ( _ZN3ARM5NVICs6IRQ100Ev = _ZN3ARM5NVICs3IRQEv );
PROVIDE ( _ZN3ARM5NVICs6IRQ101Ev = _ZN3ARM5NVICs3IRQEv );
PROVIDE ( _ZN3ARM5NVICs6IRQ102Ev = _ZN3ARM5NVICs3IRQEv );
PROVIDE ( _ZN3ARM5NVICs6IRQ103Ev = _ZN3ARM5NVICs3IRQEv );
PROVIDE ( _ZN3ARM5NVICs6IRQ104Ev = _ZN3ARM5NVICs3IRQEv );
PROVIDE ( _ZN3ARM5NVICs6IRQ105Ev = _ZN3ARM5NVICs3IRQEv );
PROVIDE ( _ZN3ARM5NVICs6IRQ106Ev = _ZN3ARM5NVICs3IRQEv );
PROVIDE ( _ZN3ARM5NVICs6IRQ107Ev = _ZN3ARM5NVICs3IRQEv );
PROVIDE ( _ZN3ARM5NVICs6IRQ108Ev = _ZN3ARM5NVICs3IRQEv );
PROVIDE ( _ZN3ARM5NVICs6IRQ109Ev = _ZN3ARM5NVICs3IRQEv );
PROVIDE ( _ZN3ARM5NVICs6IRQ110Ev = _ZN3ARM5NVICs3IRQEv );
PROVIDE ( _ZN3ARM5NVICs6IRQ111Ev = _ZN3ARM5NVICs3IRQEv );
PROVIDE ( _ZN3ARM5NVICs6IRQ112Ev = _ZN3ARM5NVICs3IRQEv );
PROVIDE ( _ZN3ARM5NVICs6IRQ113Ev = _ZN3ARM5NVICs3IRQEv );
PROVIDE ( _ZN3ARM5NVICs6IRQ114Ev = _ZN3ARM5NVICs3IRQEv );
PROVIDE ( _ZN3ARM5NVICs6IRQ115Ev = _ZN3ARM5NVICs3IRQEv );
PROVIDE ( _ZN3ARM5NVICs6IRQ116Ev = _ZN3ARM5NVICs3IRQEv );
PROVIDE ( _ZN3ARM5NVICs6IRQ117Ev = _ZN3ARM5NVICs3IRQEv );
PROVIDE ( _ZN3ARM5NVICs6IRQ118Ev = _ZN3ARM5NVICs3IRQEv );
PROVIDE ( _ZN3ARM5NVICs6IRQ119Ev = _ZN3ARM5NVICs3IRQEv );
PROVIDE ( _ZN3ARM5NVICs6IRQ120Ev = _ZN3ARM5NVICs3IRQEv );
PROVIDE ( _ZN3ARM5NVICs6IRQ121Ev = _ZN3ARM5NVICs3IRQEv );
PROVIDE ( _ZN3ARM5NVICs6IRQ122Ev = _ZN3ARM5NVICs3IRQEv );
PROVIDE ( _ZN3ARM5NVICs6IRQ123Ev = _ZN3ARM5NVICs3IRQEv );
PROVIDE ( _ZN3ARM5NVICs6IRQ124Ev = _ZN3ARM5NVICs3IRQEv );
PROVIDE ( _ZN3ARM5NVICs6IRQ125Ev = _ZN3ARM5NVICs3IRQEv );
PROVIDE ( _ZN3ARM5NVICs6IRQ126Ev = _ZN3ARM5NVICs3IRQEv );
PROVIDE ( _ZN3ARM5NVICs6IRQ127Ev = _ZN3ARM5NVICs3IRQEv );
PROVIDE ( _ZN3ARM5NVICs6IRQ128Ev = _ZN3ARM5NVICs3IRQEv );
PROVIDE ( _ZN3ARM5NVICs6IRQ129Ev = _ZN3ARM5NVICs3IRQEv );
PROVIDE ( _ZN3ARM5NVICs6IRQ130Ev = _ZN3ARM5NVICs3IRQEv );
PROVIDE ( _ZN3ARM5NVICs6IRQ131Ev = _ZN3ARM5NVICs3IRQEv );
PROVIDE ( _ZN3ARM5NVICs6IRQ132Ev = _ZN3ARM5NVICs3IRQEv );
PROVIDE ( _ZN3ARM5NVICs6IRQ133Ev = _ZN3ARM5NVICs3IRQEv );
PROVIDE ( _ZN3ARM5NVICs6IRQ134Ev = _ZN3ARM5NVICs3IRQEv );
PROVIDE ( _ZN3ARM5NVICs6IRQ135Ev = _ZN3ARM5NVICs3IRQEv );
PROVIDE ( _ZN3ARM5NVICs6IRQ136Ev = _ZN3ARM5NVICs3IRQEv );
PROVIDE ( _ZN3ARM5NVICs6IRQ137Ev = _ZN3ARM5NVICs3IRQEv );
PROVIDE ( _ZN3ARM5NVICs6IRQ138Ev = _ZN3ARM5NVICs3IRQEv );
PROVIDE ( _ZN3ARM5NVICs6IRQ139Ev = _ZN3ARM5NVICs3IRQEv );
PROVIDE ( _ZN3ARM5NVICs6IRQ140Ev = _ZN3ARM5NVICs3IRQEv );
PROVIDE ( _ZN3ARM5NVICs6IRQ141Ev = _ZN3ARM5NVICs3IRQEv );
PROVIDE ( _ZN3ARM5NVICs6IRQ142Ev = _ZN3ARM5NVICs3IRQEv );
PROVIDE ( _ZN3ARM5NVICs6IRQ143Ev = _ZN3ARM5NVICs3IRQEv );
PROVIDE ( _ZN3ARM5NVICs6IRQ144Ev = _ZN3ARM5NVICs3IRQEv );
PROVIDE ( _ZN3ARM5NVICs6IRQ145Ev = _ZN3ARM5NVICs3IRQEv );
PROVIDE ( _ZN3ARM5NVICs6IRQ146Ev = _ZN3ARM5NVICs3IRQEv );
PROVIDE ( _ZN3ARM5NVICs6IRQ147Ev = _ZN3ARM5NVICs3IRQEv );
PROVIDE ( _ZN3ARM5NVICs6IRQ148Ev = _ZN3ARM5NVICs3IRQEv );
PROVIDE ( _ZN3ARM5NVICs6IRQ149Ev = _ZN3ARM5NVICs3IRQEv );
PROVIDE ( _ZN3ARM5NVICs6IRQ150Ev = _ZN3ARM5NVICs3IRQEv );
PROVIDE ( _ZN3ARM5NVICs6IRQ151Ev = _ZN3ARM5NVICs3IRQEv );
PROVIDE ( _ZN3ARM5NVICs6IRQ152Ev = _ZN3ARM5NVICs3IRQEv );
PROVIDE ( _ZN3ARM5NVICs6IRQ153Ev = _ZN3ARM5NVICs3IRQEv );
PROVIDE ( _ZN3ARM5NVICs6IRQ154Ev = _ZN3ARM5NVICs3IRQEv );
PROVIDE ( _ZN3ARM5NVICs6IRQ155Ev = _ZN3ARM5NVICs3IRQEv );
PROVIDE ( _ZN3ARM5NVICs6IRQ156Ev = _ZN3ARM5NVICs3IRQEv );
PROVIDE ( _ZN3ARM5NVICs6IRQ157Ev = _ZN3ARM5NVICs3IRQEv );
PROVIDE ( _ZN3ARM5NVICs6IRQ158Ev = _ZN3ARM5NVICs3IRQEv );
PROVIDE ( _ZN3ARM5NVICs6IRQ159Ev = _ZN3ARM5NVICs3IRQEv );
PROVIDE ( _ZN3ARM5NVICs6IRQ160Ev = _ZN3ARM5NVICs3IRQEv );
PROVIDE ( _ZN3ARM5NVICs6IRQ161Ev = _ZN3ARM5NVICs3IRQEv );
PROVIDE ( _ZN3ARM5NVICs6IRQ162Ev = _ZN3ARM5NVICs3IRQEv );
PROVIDE ( _ZN3ARM5NVICs6IRQ163Ev = _ZN3ARM5NVICs3IRQEv );
PROVIDE ( _ZN3ARM5NVICs6IRQ164Ev = _ZN3ARM5NVICs3IRQEv );
PROVIDE ( _ZN3ARM5NVICs6IRQ165Ev = _ZN3ARM5NVICs3IRQEv );
PROVIDE ( _ZN3ARM5NVICs6IRQ166Ev = _ZN3ARM5NVICs3IRQEv );
PROVIDE ( _ZN3ARM5NVICs6IRQ167Ev = _ZN3ARM5NVICs3IRQEv );
PROVIDE ( _ZN3ARM5NVICs6IRQ168Ev = _ZN3ARM5NVICs3IRQEv );
PROVIDE ( _ZN3ARM5NVICs6IRQ169Ev = _ZN3ARM5NVICs3IRQEv );
PROVIDE ( _ZN3ARM5NVICs6IRQ170Ev = _ZN3ARM5NVICs3IRQEv );
PROVIDE ( _ZN3ARM5NVICs6IRQ171Ev = _ZN3ARM5NVICs3IRQEv );
PROVIDE ( _ZN3ARM5NVICs6IRQ172Ev = _ZN3ARM5NVICs3IRQEv );
PROVIDE ( _ZN3ARM5NVICs6IRQ173Ev = _ZN3ARM5NVICs3IRQEv );
PROVIDE ( _ZN3ARM5NVICs6IRQ174Ev = _ZN3ARM5NVICs3IRQEv );
PROVIDE ( _ZN3ARM5NVICs6IRQ175Ev = _ZN3ARM5NVICs3IRQEv );
PROVIDE ( _ZN3ARM5NVICs6IRQ176Ev = _ZN3ARM5NVICs3IRQEv );
PROVIDE ( _ZN3ARM5NVICs6IRQ177Ev = _ZN3ARM5NVICs3IRQEv );
PROVIDE ( _ZN3ARM5NVICs6IRQ178Ev = _ZN3ARM5NVICs3IRQEv );
PROVIDE ( _ZN3ARM5NVICs6IRQ179Ev = _ZN3ARM5NVICs3IRQEv );
PROVIDE ( _ZN3ARM5NVICs6IRQ180Ev = _ZN3ARM5NVICs3IRQEv );
PROVIDE ( _ZN3ARM5NVICs6IRQ181Ev = _ZN3ARM5NVICs3IRQEv );
PROVIDE ( _ZN3ARM5NVICs6IRQ182Ev = _ZN3ARM5NVICs3IRQEv );
PROVIDE ( _ZN3ARM5NVICs6IRQ183Ev = _ZN3ARM5NVICs3IRQEv );
PROVIDE ( _ZN3ARM5NVICs6IRQ184Ev = _ZN3ARM5NVICs3IRQEv );
PROVIDE ( _ZN3ARM5NVICs6IRQ185Ev = _ZN3ARM5NVICs3IRQEv );
PROVIDE ( _ZN3ARM5NVICs6IRQ186Ev = _ZN3ARM5NVICs3IRQEv );
PROVIDE ( _ZN3ARM5NVICs6IRQ187Ev = _ZN3ARM5NVICs3IRQEv );
PROVIDE ( _ZN3ARM5NVICs6IRQ188Ev = _ZN3ARM5NVICs3IRQEv );
PROVIDE ( _ZN3ARM5NVICs6IRQ189Ev = _ZN3ARM5NVICs3IRQEv );
PROVIDE ( _ZN3ARM5NVICs6IRQ190Ev = _ZN3ARM5NVICs3IRQEv );
PROVIDE ( _ZN3ARM5NVICs6IRQ191Ev = _ZN3ARM5NVICs3IRQEv );
PROVIDE ( _ZN3ARM5NVICs6IRQ192Ev = _ZN3ARM5NVICs3IRQEv );
PROVIDE ( _ZN3ARM5NVICs6IRQ193Ev = _ZN3ARM5NVICs3IRQEv );
PROVIDE ( _ZN3ARM5NVICs6IRQ194Ev = _ZN3ARM5NVICs3IRQEv );
PROVIDE ( _ZN3ARM5NVICs6IRQ195Ev = _ZN3ARM5NVICs3IRQEv );
PROVIDE ( _ZN3ARM5NVICs6IRQ196Ev = _ZN3ARM5NVICs3IRQEv );
PROVIDE ( _ZN3ARM5NVICs6IRQ197Ev = _ZN3ARM5NVICs3IRQEv );
PROVIDE ( _ZN3ARM5NVICs6IRQ198Ev = _ZN3ARM5NVICs3IRQEv );
PROVIDE ( _ZN3ARM5NVICs6IRQ199Ev = _ZN3ARM5NVICs3IRQEv );
PROVIDE ( _ZN3ARM5NVICs6IRQ200Ev = _ZN3ARM5NVICs3IRQEv );
PROVIDE ( _ZN3ARM5NVICs6IRQ201Ev = _ZN3ARM5NVICs3IRQEv );
PROVIDE ( _ZN3ARM5NVICs6IRQ202Ev = _ZN3ARM5NVICs3IRQEv );
PROVIDE ( _ZN3ARM5NVICs6IRQ203Ev = _ZN3ARM5NVICs3IRQEv );
PROVIDE ( _ZN3ARM5NVICs6IRQ204Ev = _ZN3ARM5NVICs3IRQEv );
PROVIDE ( _ZN3ARM5NVICs6IRQ205Ev = _ZN3ARM5NVICs3IRQEv );
PROVIDE ( _ZN3ARM5NVICs6IRQ206Ev = _ZN3ARM5NVICs3IRQEv );
PROVIDE ( _ZN3ARM5NVICs6IRQ207Ev = _ZN3ARM5NVICs3IRQEv );
PROVIDE ( _ZN3ARM5NVICs6IRQ208Ev = _ZN3ARM5NVICs3IRQEv );
PROVIDE ( _ZN3ARM5NVICs6IRQ209Ev = _ZN3ARM5NVICs3IRQEv );
PROVIDE ( _ZN3ARM5NVICs6IRQ210Ev = _ZN3ARM5NVICs3IRQEv );
PROVIDE ( _ZN3ARM5NVICs6IRQ211Ev = _ZN3ARM5NVICs3IRQEv );
PROVIDE ( _ZN3ARM5NVICs6IRQ212Ev = _ZN3ARM5NVICs3IRQEv );
PROVIDE ( _ZN3ARM5NVICs6IRQ213Ev = _ZN3ARM5NVICs3IRQEv );
PROVIDE ( _ZN3ARM5NVICs6IRQ214Ev = _ZN3ARM5NVICs3IRQEv );
PROVIDE ( _ZN3ARM5NVICs6IRQ215Ev = _ZN3ARM5NVICs3IRQEv );
PROVIDE ( _ZN3ARM5NVICs6IRQ216Ev = _ZN3ARM5NVICs3IRQEv );
PROVIDE ( _ZN3ARM5NVICs6IRQ217Ev = _ZN3ARM5NVICs3IRQEv );
PROVIDE ( _ZN3ARM5NVICs6IRQ218Ev = _ZN3ARM5NVICs3IRQEv );
PROVIDE ( _ZN3ARM5NVICs6IRQ219Ev = _ZN3ARM5NVICs3IRQEv );
PROVIDE ( _ZN3ARM5NVICs6IRQ220Ev = _ZN3ARM5NVICs3IRQEv );
PROVIDE ( _ZN3ARM5NVICs6IRQ221Ev = _ZN3ARM5NVICs3IRQEv );
PROVIDE ( _ZN3ARM5NVICs6IRQ222Ev = _ZN3ARM5NVICs3IRQEv );
PROVIDE ( _ZN3ARM5NVICs6IRQ223Ev = _ZN3ARM5NVICs3IRQEv );
PROVIDE ( _ZN3ARM5NVICs6IRQ224Ev = _ZN3ARM5NVICs3IRQEv );
PROVIDE ( _ZN3ARM5NVICs6IRQ225Ev = _ZN3ARM5NVICs3IRQEv );
PROVIDE ( _ZN3ARM5NVICs6IRQ226Ev = _ZN3ARM5NVICs3IRQEv );
PROVIDE ( _ZN3ARM5NVICs6IRQ227Ev = _ZN3ARM5NVICs3IRQEv );
PROVIDE ( _ZN3ARM5NVICs6IRQ228Ev = _ZN3ARM5NVICs3IRQEv );
PROVIDE ( _ZN3ARM5NVICs6IRQ229Ev = _ZN3ARM5NVICs3IRQEv );
PROVIDE ( _ZN3ARM5NVICs6IRQ230Ev = _ZN3ARM5NVICs3IRQEv );
PROVIDE ( _ZN3ARM5NVICs6IRQ231Ev = _ZN3ARM5NVICs3IRQEv );
PROVIDE ( _ZN3ARM5NVICs6IRQ232Ev = _ZN3ARM5NVICs3IRQEv );
PROVIDE ( _ZN3ARM5NVICs6IRQ233Ev = _ZN3ARM5NVICs3IRQEv );
PROVIDE ( _ZN3ARM5NVICs6IRQ234Ev = _ZN3ARM5NVICs3IRQEv );
PROVIDE ( _ZN3ARM5NVICs6IRQ235Ev = _ZN3ARM5NVICs3IRQEv );
PROVIDE ( _ZN3ARM5NVICs6IRQ236Ev = _ZN3ARM5NVICs3IRQEv );
PROVIDE ( _ZN3ARM5NVICs6IRQ237Ev = _ZN3ARM5NVICs3IRQEv );
PROVIDE ( _ZN3ARM5NVICs6IRQ238Ev = _ZN3ARM5NVICs3IRQEv );
PROVIDE ( _ZN3ARM5NVICs6IRQ239Ev = _ZN3ARM5NVICs3IRQEv );
PROVIDE ( _ZN3ARM5NVICs6IRQ240Ev = _ZN3ARM5NVICs3IRQEv );
PROVIDE ( _ZN3ARM5NVICs6IRQ241Ev = _ZN3ARM5NVICs3IRQEv );
PROVIDE ( _ZN3ARM5NVICs6IRQ242Ev = _ZN3ARM5NVICs3IRQEv );
PROVIDE ( _ZN3ARM5NVICs6IRQ243Ev = _ZN3ARM5NVICs3IRQEv );
PROVIDE ( _ZN3ARM5NVICs6IRQ244Ev = _ZN3ARM5NVICs3IRQEv );
PROVIDE ( _ZN3ARM5NVICs6IRQ245Ev = _ZN3ARM5NVICs3IRQEv );
PROVIDE ( _ZN3ARM5NVICs6IRQ246Ev = _ZN3ARM5NVICs3IRQEv );
PROVIDE ( _ZN3ARM5NVICs6IRQ247Ev = _ZN3ARM5NVICs3IRQEv );
PROVIDE ( _ZN3ARM5NVICs6IRQ248Ev = _ZN3ARM5NVICs3IRQEv );
PROVIDE ( _ZN3ARM5NVICs6IRQ249Ev = _ZN3ARM5NVICs3IRQEv );
PROVIDE ( _ZN3ARM5NVICs6IRQ250Ev = _ZN3ARM5NVICs3IRQEv );
PROVIDE ( _ZN3ARM5NVICs6IRQ251Ev = _ZN3ARM5NVICs3IRQEv );
PROVIDE ( _ZN3ARM5NVICs6IRQ252Ev = _ZN3ARM5NVICs3IRQEv );
PROVIDE ( _ZN3ARM5NVICs6IRQ253Ev = _ZN3ARM5NVICs3IRQEv );
PROVIDE ( _ZN3ARM5NVICs6IRQ254Ev = _ZN3ARM5NVICs3IRQEv );
PROVIDE ( _ZN3ARM5NVICs6IRQ255Ev = _ZN3ARM5NVICs3IRQEv );
