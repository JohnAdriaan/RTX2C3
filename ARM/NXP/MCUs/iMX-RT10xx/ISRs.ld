/*
 * © 2019 John Adriaan. Licensed under the "3-clause BSD License"
 *
 * \file ARM/NXP/MCUs/ISRs.ld
 * 
 * Included by main linker script to PROVIDE (literally!) default implementations
 * for all NXP-based ISRs.
 */

/*
 * Function name mangling is of the form:
 * "_Z" : Mangled name
 * "N"  : (optional) Nested (used for namespace or sub-definitions)
 * <#>  : Number of characters
 * <$>  : String
 * [#$] : (if Nested) More of the same
 * "E"  : (if Nested) End of Nesting
 * "v"  : void parameters 
 */

/* Set all undefined IRQs to `ARM::ISRs::Invalid()` */
/* Note these NEED to be listed BEFORE the same ones in `ARM/NVICs/NVIC.ld` */
_ZN3ARM5NVICs5IRQ52Ev = _ZN3ARM4ISRs7InvalidEv; /* ARM::ISRs::IRQ52() */
_ZN3ARM5NVICs5IRQ54Ev = _ZN3ARM4ISRs7InvalidEv; /* ARM::ISRs::IRQ54() */
_ZN3ARM5NVICs5IRQ55Ev = _ZN3ARM4ISRs7InvalidEv; /* ARM::ISRs::IRQ55() */

/* Default all defined IRQs to their `ARM::NVICs::IRQ`#`()` */
PROVIDE ( _ZN3ARM3NXP4ISRs8eDMA_Ch0Ev          = _ZN3ARM5NVICs4IRQ0Ev  ); /* ARM::NXP::ISRs::eDMA_Ch0() */
PROVIDE ( _ZN3ARM3NXP4ISRs8eDMA_Ch1Ev          = _ZN3ARM5NVICs4IRQ1Ev  ); /* ARM::NXP::ISRs::eDMA_Ch1() */
PROVIDE ( _ZN3ARM3NXP4ISRs8eDMA_Ch2Ev          = _ZN3ARM5NVICs4IRQ2Ev  ); /* ARM::NXP::ISRs::eDMA_Ch2() */
PROVIDE ( _ZN3ARM3NXP4ISRs8eDMA_Ch3Ev          = _ZN3ARM5NVICs4IRQ3Ev  ); /* ARM::NXP::ISRs::eDMA_Ch3() */
PROVIDE ( _ZN3ARM3NXP4ISRs8eDMA_Ch4Ev          = _ZN3ARM5NVICs4IRQ4Ev  ); /* ARM::NXP::ISRs::eDMA_Ch4() */
PROVIDE ( _ZN3ARM3NXP4ISRs8eDMA_Ch5Ev          = _ZN3ARM5NVICs4IRQ5Ev  ); /* ARM::NXP::ISRs::eDMA_Ch5() */
PROVIDE ( _ZN3ARM3NXP4ISRs8eDMA_Ch6Ev          = _ZN3ARM5NVICs4IRQ6Ev  ); /* ARM::NXP::ISRs::eDMA_Ch6() */
PROVIDE ( _ZN3ARM3NXP4ISRs8eDMA_Ch7Ev          = _ZN3ARM5NVICs4IRQ7Ev  ); /* ARM::NXP::ISRs::eDMA_Ch7() */
PROVIDE ( _ZN3ARM3NXP4ISRs8eDMA_Ch8Ev          = _ZN3ARM5NVICs4IRQ8Ev  ); /* ARM::NXP::ISRs::eDMA_Ch8() */
PROVIDE ( _ZN3ARM3NXP4ISRs8eDMA_Ch9Ev          = _ZN3ARM5NVICs4IRQ9Ev  ); /* ARM::NXP::ISRs::eDMA_Ch9() */
PROVIDE ( _ZN3ARM3NXP4ISRs9eDMA_Ch10Ev         = _ZN3ARM5NVICs5IRQ10Ev ); /* ARM::NXP::ISRs::eDMA_Ch10() */
PROVIDE ( _ZN3ARM3NXP4ISRs9eDMA_Ch11Ev         = _ZN3ARM5NVICs5IRQ11Ev ); /* ARM::NXP::ISRs::eDMA_Ch11() */
PROVIDE ( _ZN3ARM3NXP4ISRs9eDMA_Ch12Ev         = _ZN3ARM5NVICs5IRQ12Ev ); /* ARM::NXP::ISRs::eDMA_Ch12() */
PROVIDE ( _ZN3ARM3NXP4ISRs9eDMA_Ch13Ev         = _ZN3ARM5NVICs5IRQ13Ev ); /* ARM::NXP::ISRs::eDMA_Ch13() */
PROVIDE ( _ZN3ARM3NXP4ISRs9eDMA_Ch14Ev         = _ZN3ARM5NVICs5IRQ14Ev ); /* ARM::NXP::ISRs::eDMA_Ch14() */
PROVIDE ( _ZN3ARM3NXP4ISRs9eDMA_Ch15Ev         = _ZN3ARM5NVICs5IRQ15Ev ); /* ARM::NXP::ISRs::eDMA_Ch15() */
PROVIDE ( _ZN3ARM3NXP4ISRs10eDMA_ErrorEv       = _ZN3ARM5NVICs5IRQ16Ev ); /* ARM::NXP::ISRs::eDMA_Error() */
PROVIDE ( _ZN3ARM3NXP4ISRs8CTI_IRQ0Ev          = _ZN3ARM5NVICs5IRQ17Ev ); /* ARM::NXP::ISRs::CTI_IRQ0() */
PROVIDE ( _ZN3ARM3NXP4ISRs8CTI_IRQ1Ev          = _ZN3ARM5NVICs5IRQ18Ev ); /* ARM::NXP::ISRs::CTI_IRQ1() */
PROVIDE ( _ZN3ARM3NXP4ISRs13CM7_ExceptionEv    = _ZN3ARM5NVICs5IRQ19Ev ); /* ARM::NXP::ISRs::CM7_Exception() */
PROVIDE ( _ZN3ARM3NXP4ISRs7LPUART1Ev           = _ZN3ARM5NVICs5IRQ20Ev ); /* ARM::NXP::ISRs::LPUART1() */
PROVIDE ( _ZN3ARM3NXP4ISRs7LPUART2Ev           = _ZN3ARM5NVICs5IRQ21Ev ); /* ARM::NXP::ISRs::LPUART2() */
PROVIDE ( _ZN3ARM3NXP4ISRs7LPUART3Ev           = _ZN3ARM5NVICs5IRQ22Ev ); /* ARM::NXP::ISRs::LPUART3() */
PROVIDE ( _ZN3ARM3NXP4ISRs7LPUART4Ev           = _ZN3ARM5NVICs5IRQ23Ev ); /* ARM::NXP::ISRs::LPUART4() */
PROVIDE ( _ZN3ARM3NXP4ISRs3PITEv               = _ZN3ARM5NVICs5IRQ24Ev ); /* ARM::NXP::ISRs::PIT() */
PROVIDE ( _ZN3ARM3NXP4ISRs3USBEv               = _ZN3ARM5NVICs5IRQ25Ev ); /* ARM::NXP::ISRs::USB() */
PROVIDE ( _ZN3ARM3NXP4ISRs7FlexSPIEv           = _ZN3ARM5NVICs5IRQ26Ev ); /* ARM::NXP::ISRs::FlexSPI() */
PROVIDE ( _ZN3ARM3NXP4ISRs7FlexRAMEv           = _ZN3ARM5NVICs5IRQ27Ev ); /* ARM::NXP::ISRs::FlexRAM() */
PROVIDE ( _ZN3ARM3NXP4ISRs6LPI2C1Ev            = _ZN3ARM5NVICs5IRQ28Ev ); /* ARM::NXP::ISRs::LPI2C1() */
PROVIDE ( _ZN3ARM3NXP4ISRs6LPI2C2Ev            = _ZN3ARM5NVICs5IRQ29Ev ); /* ARM::NXP::ISRs::LPI2C2() */
PROVIDE ( _ZN3ARM3NXP4ISRs4GPT1Ev              = _ZN3ARM5NVICs5IRQ30Ev ); /* ARM::NXP::ISRs::GPT1() */
PROVIDE ( _ZN3ARM3NXP4ISRs4GPT2Ev              = _ZN3ARM5NVICs5IRQ31Ev ); /* ARM::NXP::ISRs::GPT2() */
PROVIDE ( _ZN3ARM3NXP4ISRs6LPSPI1Ev            = _ZN3ARM5NVICs5IRQ32Ev ); /* ARM::NXP::ISRs::LPSPI1() */
PROVIDE ( _ZN3ARM3NXP4ISRs6LPSPI2Ev            = _ZN3ARM5NVICs5IRQ33Ev ); /* ARM::NXP::ISRs::LPSPI2() */
PROVIDE ( _ZN3ARM3NXP4ISRs4PWM0Ev              = _ZN3ARM5NVICs5IRQ34Ev ); /* ARM::NXP::ISRs::PWM0() */
PROVIDE ( _ZN3ARM3NXP4ISRs4PWM1Ev              = _ZN3ARM5NVICs5IRQ35Ev ); /* ARM::NXP::ISRs::PWM1() */
PROVIDE ( _ZN3ARM3NXP4ISRs4PWM2Ev              = _ZN3ARM5NVICs5IRQ36Ev ); /* ARM::NXP::ISRs::PWM2() */
PROVIDE ( _ZN3ARM3NXP4ISRs4PWM3Ev              = _ZN3ARM5NVICs5IRQ37Ev ); /* ARM::NXP::ISRs::PWM3() */
PROVIDE ( _ZN3ARM3NXP4ISRs9PWM_ErrorEv         = _ZN3ARM5NVICs5IRQ38Ev ); /* ARM::NXP::ISRs::PWM_Error() */
PROVIDE ( _ZN3ARM3NXP4ISRs3KPPEv               = _ZN3ARM5NVICs5IRQ39Ev ); /* ARM::NXP::ISRs::KPP() */
PROVIDE ( _ZN3ARM3NXP4ISRs3SRCEv               = _ZN3ARM5NVICs5IRQ40Ev ); /* ARM::NXP::ISRs::SRC() */
PROVIDE ( _ZN3ARM3NXP4ISRs3GPREv               = _ZN3ARM5NVICs5IRQ41Ev ); /* ARM::NXP::ISRs::GPR() */
PROVIDE ( _ZN3ARM3NXP4ISRs4CCM1Ev              = _ZN3ARM5NVICs5IRQ42Ev ); /* ARM::NXP::ISRs::CCM1() */
PROVIDE ( _ZN3ARM3NXP4ISRs4CCM2Ev              = _ZN3ARM5NVICs5IRQ43Ev ); /* ARM::NXP::ISRs::CCM2() */
PROVIDE ( _ZN3ARM3NXP4ISRs3EWMEv               = _ZN3ARM5NVICs5IRQ44Ev ); /* ARM::NXP::ISRs::EWM() */
PROVIDE ( _ZN3ARM3NXP4ISRs5WDOG2Ev             = _ZN3ARM5NVICs5IRQ45Ev ); /* ARM::NXP::ISRs::WDOG2() */
PROVIDE ( _ZN3ARM3NXP4ISRs7SNVS_HPEv           = _ZN3ARM5NVICs5IRQ46Ev ); /* ARM::NXP::ISRs::SNVS_HP() */
PROVIDE ( _ZN3ARM3NXP4ISRs16SNVS_HP_SecurityEv = _ZN3ARM5NVICs5IRQ47Ev ); /* ARM::NXP::ISRs::SNVS_HP_Security() */
PROVIDE ( _ZN3ARM3NXP4ISRs10SNVS_ShortEv       = _ZN3ARM5NVICs5IRQ48Ev ); /* ARM::NXP::ISRs::SNVS_Short() */
PROVIDE ( _ZN3ARM3NXP4ISRs3CSUEv               = _ZN3ARM5NVICs5IRQ49Ev ); /* ARM::NXP::ISRs::CSU() */
PROVIDE ( _ZN3ARM3NXP4ISRs7DCP_CRCEv           = _ZN3ARM5NVICs5IRQ50Ev ); /* ARM::NXP::ISRs::DCP_CRC() */
PROVIDE ( _ZN3ARM3NXP4ISRs7DCP_Ch0Ev           = _ZN3ARM5NVICs5IRQ51Ev ); /* ARM::NXP::ISRs::DCP_Ch0() */
PROVIDE ( _ZN3ARM3NXP4ISRs4TRNGEv              = _ZN3ARM5NVICs5IRQ53Ev ); /* ARM::NXP::ISRs::TRNG() */
PROVIDE ( _ZN3ARM3NXP4ISRs4SAI1Ev              = _ZN3ARM5NVICs5IRQ56Ev ); /* ARM::NXP::ISRs::SAI1() */
PROVIDE ( _ZN3ARM3NXP4ISRs6RTWDOGEv            = _ZN3ARM5NVICs5IRQ57Ev ); /* ARM::NXP::ISRs::RTWDOG() */
PROVIDE ( _ZN3ARM3NXP4ISRs7SAI3_RXEv           = _ZN3ARM5NVICs5IRQ58Ev ); /* ARM::NXP::ISRs::SAI3_RX() */
PROVIDE ( _ZN3ARM3NXP4ISRs7SAI3_TXEv           = _ZN3ARM5NVICs5IRQ59Ev ); /* ARM::NXP::ISRs::SAI3_TX() */
PROVIDE ( _ZN3ARM3NXP4ISRs5SPDIFEv             = _ZN3ARM5NVICs5IRQ60Ev ); /* ARM::NXP::ISRs::SPDIF() */
PROVIDE ( _ZN3ARM3NXP4ISRs3PMUEv               = _ZN3ARM5NVICs5IRQ61Ev ); /* ARM::NXP::ISRs::PMU() */
PROVIDE ( _ZN3ARM3NXP4ISRs5XBAR1Ev             = _ZN3ARM5NVICs5IRQ62Ev ); /* ARM::NXP::ISRs::XBAR1() */
PROVIDE ( _ZN3ARM3NXP4ISRs4TempEv              = _ZN3ARM5NVICs5IRQ63Ev ); /* ARM::NXP::ISRs::Temp() */
PROVIDE ( _ZN3ARM3NXP4ISRs10Temp_PanicEv       = _ZN3ARM5NVICs5IRQ64Ev ); /* ARM::NXP::ISRs::Temp_Panic() */
PROVIDE ( _ZN3ARM3NXP4ISRs7USB_PHYEv           = _ZN3ARM5NVICs5IRQ65Ev ); /* ARM::NXP::ISRs::USB_PHY() */
PROVIDE ( _ZN3ARM3NXP4ISRs3GPCEv               = _ZN3ARM5NVICs5IRQ66Ev ); /* ARM::NXP::ISRs::GPC() */
PROVIDE ( _ZN3ARM3NXP4ISRs4ADC1Ev              = _ZN3ARM5NVICs5IRQ67Ev ); /* ARM::NXP::ISRs::ADC1() */
PROVIDE ( _ZN3ARM3NXP4ISRs7FlexIO1Ev           = _ZN3ARM5NVICs5IRQ68Ev ); /* ARM::NXP::ISRs::FlexIO1() */
PROVIDE ( _ZN3ARM3NXP4ISRs4DCDCEv              = _ZN3ARM5NVICs5IRQ69Ev ); /* ARM::NXP::ISRs::DCDC() */
PROVIDE ( _ZN3ARM3NXP4ISRs8GPIO1_LoEv          = _ZN3ARM5NVICs5IRQ70Ev ); /* ARM::NXP::ISRs::GPIO1_Lo() */
PROVIDE ( _ZN3ARM3NXP4ISRs8GPIO1_HiEv          = _ZN3ARM5NVICs5IRQ71Ev ); /* ARM::NXP::ISRs::GPIO1_Hi() */
PROVIDE ( _ZN3ARM3NXP4ISRs5GPIO2Ev             = _ZN3ARM5NVICs5IRQ72Ev ); /* ARM::NXP::ISRs::GPIO2() */
PROVIDE ( _ZN3ARM3NXP4ISRs5GPIO5Ev             = _ZN3ARM5NVICs5IRQ73Ev ); /* ARM::NXP::ISRs::GPIO5() */
PROVIDE ( _ZN3ARM3NXP4ISRs5WDOG1Ev             = _ZN3ARM5NVICs5IRQ74Ev ); /* ARM::NXP::ISRs::WDOG1() */
PROVIDE ( _ZN3ARM3NXP4ISRs9ADC_ETC_0Ev         = _ZN3ARM5NVICs5IRQ75Ev ); /* ARM::NXP::ISRs::ADC_ETC_0() */
PROVIDE ( _ZN3ARM3NXP4ISRs9ADC_ETC_1Ev         = _ZN3ARM5NVICs5IRQ76Ev ); /* ARM::NXP::ISRs::ADC_ETC_1() */
PROVIDE ( _ZN3ARM3NXP4ISRs9ADC_ETC_2Ev         = _ZN3ARM5NVICs5IRQ77Ev ); /* ARM::NXP::ISRs::ADC_ETC_2() */
PROVIDE ( _ZN3ARM3NXP4ISRs9ADC_ETC_3Ev         = _ZN3ARM5NVICs5IRQ78Ev ); /* ARM::NXP::ISRs::ADC_ETC_3() */
PROVIDE ( _ZN3ARM3NXP4ISRs13ADC_ETC_ErrorEv    = _ZN3ARM5NVICs5IRQ79Ev ); /* ARM::NXP::ISRs::ADC_ETC_Error() */

/* Assign all `ARM::NVIC::IRQ`#`()` to their named handler. */
/* Note that if a handler hasn't been defined, the above `PROVIDE`s satisfies these - which then use `ARM/NVICs/NVIC.ld`*/
PROVIDE ( _ZN3ARM5NVICs4IRQ0Ev  = _ZN3ARM3NXP4ISRs8eDMA_Ch0Ev );          /* ARM::NXP::ISRs::eDMA_Ch0() */
PROVIDE ( _ZN3ARM5NVICs4IRQ1Ev  = _ZN3ARM3NXP4ISRs8eDMA_Ch1Ev );          /* ARM::NXP::ISRs::eDMA_Ch1() */
PROVIDE ( _ZN3ARM5NVICs4IRQ2Ev  = _ZN3ARM3NXP4ISRs8eDMA_Ch2Ev );          /* ARM::NXP::ISRs::eDMA_Ch2() */
PROVIDE ( _ZN3ARM5NVICs4IRQ3Ev  = _ZN3ARM3NXP4ISRs8eDMA_Ch3Ev );          /* ARM::NXP::ISRs::eDMA_Ch3() */
PROVIDE ( _ZN3ARM5NVICs4IRQ4Ev  = _ZN3ARM3NXP4ISRs8eDMA_Ch4Ev );          /* ARM::NXP::ISRs::eDMA_Ch4() */
PROVIDE ( _ZN3ARM5NVICs4IRQ5Ev  = _ZN3ARM3NXP4ISRs8eDMA_Ch5Ev );          /* ARM::NXP::ISRs::eDMA_Ch5() */
PROVIDE ( _ZN3ARM5NVICs4IRQ6Ev  = _ZN3ARM3NXP4ISRs8eDMA_Ch6Ev );          /* ARM::NXP::ISRs::eDMA_Ch6() */
PROVIDE ( _ZN3ARM5NVICs4IRQ7Ev  = _ZN3ARM3NXP4ISRs8eDMA_Ch7Ev );          /* ARM::NXP::ISRs::eDMA_Ch7() */
PROVIDE ( _ZN3ARM5NVICs4IRQ8Ev  = _ZN3ARM3NXP4ISRs8eDMA_Ch8Ev );          /* ARM::NXP::ISRs::eDMA_Ch8() */
PROVIDE ( _ZN3ARM5NVICs4IRQ9Ev  = _ZN3ARM3NXP4ISRs8eDMA_Ch9Ev );          /* ARM::NXP::ISRs::eDMA_Ch9() */
PROVIDE ( _ZN3ARM5NVICs5IRQ10Ev = _ZN3ARM3NXP4ISRs9eDMA_Ch10Ev );         /* ARM::NXP::ISRs::eDMA_Ch10() */
PROVIDE ( _ZN3ARM5NVICs5IRQ11Ev = _ZN3ARM3NXP4ISRs9eDMA_Ch11Ev );         /* ARM::NXP::ISRs::eDMA_Ch11() */
PROVIDE ( _ZN3ARM5NVICs5IRQ12Ev = _ZN3ARM3NXP4ISRs9eDMA_Ch12Ev );         /* ARM::NXP::ISRs::eDMA_Ch12() */
PROVIDE ( _ZN3ARM5NVICs5IRQ13Ev = _ZN3ARM3NXP4ISRs9eDMA_Ch13Ev );         /* ARM::NXP::ISRs::eDMA_Ch13() */
PROVIDE ( _ZN3ARM5NVICs5IRQ14Ev = _ZN3ARM3NXP4ISRs9eDMA_Ch14Ev );         /* ARM::NXP::ISRs::eDMA_Ch14() */
PROVIDE ( _ZN3ARM5NVICs5IRQ15Ev = _ZN3ARM3NXP4ISRs9eDMA_Ch15Ev );         /* ARM::NXP::ISRs::eDMA_Ch15() */
PROVIDE ( _ZN3ARM5NVICs5IRQ16Ev = _ZN3ARM3NXP4ISRs10eDMA_ErrorEv );       /* ARM::NXP::ISRs::eDMA_Error() */
PROVIDE ( _ZN3ARM5NVICs5IRQ17Ev = _ZN3ARM3NXP4ISRs8CTI_IRQ0Ev );          /* ARM::NXP::ISRs::CTI_IRQ0() */
PROVIDE ( _ZN3ARM5NVICs5IRQ18Ev = _ZN3ARM3NXP4ISRs8CTI_IRQ1Ev );          /* ARM::NXP::ISRs::CTI_IRQ1() */
PROVIDE ( _ZN3ARM5NVICs5IRQ19Ev = _ZN3ARM3NXP4ISRs13CM7_ExceptionEv );    /* ARM::NXP::ISRs::CM7_Exception() */
PROVIDE ( _ZN3ARM5NVICs5IRQ20Ev = _ZN3ARM3NXP4ISRs7LPUART1Ev );           /* ARM::NXP::ISRs::LPUART1() */
PROVIDE ( _ZN3ARM5NVICs5IRQ21Ev = _ZN3ARM3NXP4ISRs7LPUART2Ev );           /* ARM::NXP::ISRs::LPUART2() */
PROVIDE ( _ZN3ARM5NVICs5IRQ22Ev = _ZN3ARM3NXP4ISRs7LPUART3Ev );           /* ARM::NXP::ISRs::LPUART3() */
PROVIDE ( _ZN3ARM5NVICs5IRQ23Ev = _ZN3ARM3NXP4ISRs7LPUART4Ev );           /* ARM::NXP::ISRs::LPUART4() */
PROVIDE ( _ZN3ARM5NVICs5IRQ24Ev = _ZN3ARM3NXP4ISRs3PITEv );               /* ARM::NXP::ISRs::PIT() */
PROVIDE ( _ZN3ARM5NVICs5IRQ25Ev = _ZN3ARM3NXP4ISRs3USBEv );               /* ARM::NXP::ISRs::USB() */
PROVIDE ( _ZN3ARM5NVICs5IRQ26Ev = _ZN3ARM3NXP4ISRs7FlexSPIEv );           /* ARM::NXP::ISRs::FlexSPI() */
PROVIDE ( _ZN3ARM5NVICs5IRQ27Ev = _ZN3ARM3NXP4ISRs7FlexRAMEv );           /* ARM::NXP::ISRs::FlexRAM() */
PROVIDE ( _ZN3ARM5NVICs5IRQ28Ev = _ZN3ARM3NXP4ISRs6LPI2C1Ev );            /* ARM::NXP::ISRs::LPI2C1() */
PROVIDE ( _ZN3ARM5NVICs5IRQ29Ev = _ZN3ARM3NXP4ISRs6LPI2C2Ev );            /* ARM::NXP::ISRs::LPI2C2() */
PROVIDE ( _ZN3ARM5NVICs5IRQ30Ev = _ZN3ARM3NXP4ISRs4GPT1Ev );              /* ARM::NXP::ISRs::GPT1() */
PROVIDE ( _ZN3ARM5NVICs5IRQ31Ev = _ZN3ARM3NXP4ISRs4GPT2Ev );              /* ARM::NXP::ISRs::GPT2() */
PROVIDE ( _ZN3ARM5NVICs5IRQ32Ev = _ZN3ARM3NXP4ISRs6LPSPI1Ev );            /* ARM::NXP::ISRs::LPSPI1() */
PROVIDE ( _ZN3ARM5NVICs5IRQ33Ev = _ZN3ARM3NXP4ISRs6LPSPI2Ev );            /* ARM::NXP::ISRs::LPSPI2() */
PROVIDE ( _ZN3ARM5NVICs5IRQ34Ev = _ZN3ARM3NXP4ISRs4PWM0Ev );              /* ARM::NXP::ISRs::PWM0() */
PROVIDE ( _ZN3ARM5NVICs5IRQ35Ev = _ZN3ARM3NXP4ISRs4PWM1Ev );              /* ARM::NXP::ISRs::PWM1() */
PROVIDE ( _ZN3ARM5NVICs5IRQ36Ev = _ZN3ARM3NXP4ISRs4PWM2Ev );              /* ARM::NXP::ISRs::PWM2() */
PROVIDE ( _ZN3ARM5NVICs5IRQ37Ev = _ZN3ARM3NXP4ISRs4PWM3Ev );              /* ARM::NXP::ISRs::PWM3() */
PROVIDE ( _ZN3ARM5NVICs5IRQ38Ev = _ZN3ARM3NXP4ISRs9PWM_ErrorEv );         /* ARM::NXP::ISRs::PWM_Error() */
PROVIDE ( _ZN3ARM5NVICs5IRQ39Ev = _ZN3ARM3NXP4ISRs3KPPEv );               /* ARM::NXP::ISRs::KPP() */
PROVIDE ( _ZN3ARM5NVICs5IRQ40Ev = _ZN3ARM3NXP4ISRs3SRCEv );               /* ARM::NXP::ISRs::SRC() */
PROVIDE ( _ZN3ARM5NVICs5IRQ41Ev = _ZN3ARM3NXP4ISRs3GPREv );               /* ARM::NXP::ISRs::GPR() */
PROVIDE ( _ZN3ARM5NVICs5IRQ42Ev = _ZN3ARM3NXP4ISRs4CCM1Ev );              /* ARM::NXP::ISRs::CCM1() */
PROVIDE ( _ZN3ARM5NVICs5IRQ43Ev = _ZN3ARM3NXP4ISRs4CCM2Ev );              /* ARM::NXP::ISRs::CCM2() */
PROVIDE ( _ZN3ARM5NVICs5IRQ44Ev = _ZN3ARM3NXP4ISRs3EWMEv );               /* ARM::NXP::ISRs::EWM() */
PROVIDE ( _ZN3ARM5NVICs5IRQ45Ev = _ZN3ARM3NXP4ISRs5WDOG2Ev );             /* ARM::NXP::ISRs::WDOG2() */
PROVIDE ( _ZN3ARM5NVICs5IRQ46Ev = _ZN3ARM3NXP4ISRs7SNVS_HPEv );           /* ARM::NXP::ISRs::SNVS_HP() */
PROVIDE ( _ZN3ARM5NVICs5IRQ47Ev = _ZN3ARM3NXP4ISRs16SNVS_HP_SecurityEv ); /* ARM::NXP::ISRs::SNVS_HP_Security() */
PROVIDE ( _ZN3ARM5NVICs5IRQ48Ev = _ZN3ARM3NXP4ISRs10SNVS_ShortEv );       /* ARM::NXP::ISRs::SNVS_Short() */
PROVIDE ( _ZN3ARM5NVICs5IRQ49Ev = _ZN3ARM3NXP4ISRs3CSUEv );               /* ARM::NXP::ISRs::CSU() */
PROVIDE ( _ZN3ARM5NVICs5IRQ50Ev = _ZN3ARM3NXP4ISRs7DCP_CRCEv );           /* ARM::NXP::ISRs::DCP_CRC() */
PROVIDE ( _ZN3ARM5NVICs5IRQ51Ev = _ZN3ARM3NXP4ISRs7DCP_Ch0Ev );           /* ARM::NXP::ISRs::DCP_Ch0() */
PROVIDE ( _ZN3ARM5NVICs5IRQ53Ev = _ZN3ARM3NXP4ISRs4TRNGEv );              /* ARM::NXP::ISRs::TRNG() */
PROVIDE ( _ZN3ARM5NVICs5IRQ56Ev = _ZN3ARM3NXP4ISRs4SAI1Ev );              /* ARM::NXP::ISRs::SAI1() */
PROVIDE ( _ZN3ARM5NVICs5IRQ57Ev = _ZN3ARM3NXP4ISRs6RTWDOGEv );            /* ARM::NXP::ISRs::RTWDOG() */
PROVIDE ( _ZN3ARM5NVICs5IRQ58Ev = _ZN3ARM3NXP4ISRs7SAI3_RXEv );           /* ARM::NXP::ISRs::SAI3_RX() */
PROVIDE ( _ZN3ARM5NVICs5IRQ59Ev = _ZN3ARM3NXP4ISRs7SAI3_TXEv );           /* ARM::NXP::ISRs::SAI3_TX() */
PROVIDE ( _ZN3ARM5NVICs5IRQ60Ev = _ZN3ARM3NXP4ISRs5SPDIFEv );             /* ARM::NXP::ISRs::SPDIF() */
PROVIDE ( _ZN3ARM5NVICs5IRQ61Ev = _ZN3ARM3NXP4ISRs3PMUEv );               /* ARM::NXP::ISRs::PMU() */
PROVIDE ( _ZN3ARM5NVICs5IRQ62Ev = _ZN3ARM3NXP4ISRs5XBAR1Ev );             /* ARM::NXP::ISRs::XBAR1() */
PROVIDE ( _ZN3ARM5NVICs5IRQ63Ev = _ZN3ARM3NXP4ISRs4TempEv );              /* ARM::NXP::ISRs::Temp() */
PROVIDE ( _ZN3ARM5NVICs5IRQ64Ev = _ZN3ARM3NXP4ISRs10Temp_PanicEv );       /* ARM::NXP::ISRs::Temp_Panic() */
PROVIDE ( _ZN3ARM5NVICs5IRQ65Ev = _ZN3ARM3NXP4ISRs7USB_PHYEv );           /* ARM::NXP::ISRs::USB_PHY() */
PROVIDE ( _ZN3ARM5NVICs5IRQ66Ev = _ZN3ARM3NXP4ISRs3GPCEv );               /* ARM::NXP::ISRs::GPC() */
PROVIDE ( _ZN3ARM5NVICs5IRQ67Ev = _ZN3ARM3NXP4ISRs4ADC1Ev );              /* ARM::NXP::ISRs::ADC1() */
PROVIDE ( _ZN3ARM5NVICs5IRQ68Ev = _ZN3ARM3NXP4ISRs7FlexIO1Ev );           /* ARM::NXP::ISRs::FlexIO1() */
PROVIDE ( _ZN3ARM5NVICs5IRQ69Ev = _ZN3ARM3NXP4ISRs4DCDCEv );              /* ARM::NXP::ISRs::DCDC() */
PROVIDE ( _ZN3ARM5NVICs5IRQ70Ev = _ZN3ARM3NXP4ISRs8GPIO1_LoEv );          /* ARM::NXP::ISRs::GPIO1_Lo() */
PROVIDE ( _ZN3ARM5NVICs5IRQ71Ev = _ZN3ARM3NXP4ISRs8GPIO1_HiEv );          /* ARM::NXP::ISRs::GPIO1_Hi() */
PROVIDE ( _ZN3ARM5NVICs5IRQ72Ev = _ZN3ARM3NXP4ISRs5GPIO2Ev );             /* ARM::NXP::ISRs::GPIO2() */
PROVIDE ( _ZN3ARM5NVICs5IRQ73Ev = _ZN3ARM3NXP4ISRs5GPIO5Ev );             /* ARM::NXP::ISRs::GPIO5() */
PROVIDE ( _ZN3ARM5NVICs5IRQ74Ev = _ZN3ARM3NXP4ISRs5WDOG1Ev );             /* ARM::NXP::ISRs::WDOG1() */
PROVIDE ( _ZN3ARM5NVICs5IRQ75Ev = _ZN3ARM3NXP4ISRs9ADC_ETC_0Ev );         /* ARM::NXP::ISRs::ADC_ETC_0() */
PROVIDE ( _ZN3ARM5NVICs5IRQ76Ev = _ZN3ARM3NXP4ISRs9ADC_ETC_1Ev );         /* ARM::NXP::ISRs::ADC_ETC_1() */
PROVIDE ( _ZN3ARM5NVICs5IRQ77Ev = _ZN3ARM3NXP4ISRs9ADC_ETC_2Ev );         /* ARM::NXP::ISRs::ADC_ETC_2() */
PROVIDE ( _ZN3ARM5NVICs5IRQ78Ev = _ZN3ARM3NXP4ISRs9ADC_ETC_3Ev );         /* ARM::NXP::ISRs::ADC_ETC_3() */
PROVIDE ( _ZN3ARM5NVICs5IRQ79Ev = _ZN3ARM3NXP4ISRs13ADC_ETC_ErrorEv );    /* ARM::NXP::ISRs::ADC_ETC_Error() */
